## CMakeLists.txt
```
cmake_minimum_required(VERSION 3.13.1)

# Set the board before finding Zephyr
set(BOARD native_posix)

# Find Zephyr package
find_package(Zephyr REQUIRED HINTS $ENV{ZEPHYR_BASE})
project(zephyr_app)

# Add source files from src directory
target_sources(app PRIVATE src/Zephyr_Thread_Creation.c)
```

## prj.conf
```kconfig
CONFIG_MAIN_STACK_SIZE=1024
CONFIG_SYS_CLOCK_TICKS_PER_SEC=100
# Enable networking support
CONFIG_NETWORKING=y

# Enable TCP support
CONFIG_NET_TCP=y

# Other configuration options
```

## src/Zephyr_Attr.c
```c
#include <zephyr.h>
#include <sys/printk.h>

#define STACK_SIZE 1024
#define PRIORITY 7

K_THREAD_STACK_DEFINE(thread_attr_stack, STACK_SIZE);
struct k_thread thread_attr_data;

void thread_attr_function(void *arg1, void *arg2, void *arg3) {
    printk("Thread is running\n");
}

void main(void) {
    k_tid_t thread_tid = k_thread_create(&thread_attr_data, thread_attr_stack, STACK_SIZE,
                                         thread_attr_function, NULL, NULL, NULL,
                                         PRIORITY, 0, K_NO_WAIT);

    k_thread_join(thread_tid, K_FOREVER);

    printk("Thread has finished execution\n");
}
```

## src/Zephyr_Sync.c
```c
#include <zephyr.h>
#include <sys/printk.h>

#define STACK_SIZE 1024
#define PRIORITY 7

K_THREAD_STACK_DEFINE(thread_sync1_stack, STACK_SIZE);
K_THREAD_STACK_DEFINE(thread_sync2_stack, STACK_SIZE);
struct k_thread thread_sync1_data;
struct k_thread thread_sync2_data;

int sharedCounter = 0;
struct k_mutex my_mutex;

void incrementCounter(void *arg1, void *arg2, void *arg3) {
    for (int i = 0; i < 100000; i++) {
        k_mutex_lock(&my_mutex, K_FOREVER);
        sharedCounter++;
        k_mutex_unlock(&my_mutex);
    }
}

void main(void) {
    k_mutex_init(&my_mutex);

    k_tid_t thread1_tid = k_thread_create(&thread_sync1_data, thread_sync1_stack, STACK_SIZE,
                                          incrementCounter, NULL, NULL, NULL,
                                          PRIORITY, 0, K_NO_WAIT);

    k_tid_t thread2_tid = k_thread_create(&thread_sync2_data, thread_sync2_stack, STACK_SIZE,
                                          incrementCounter, NULL, NULL, NULL,
                                          PRIORITY, 0, K_NO_WAIT);

    k_thread_join(thread1_tid, K_FOREVER);
    k_thread_join(thread2_tid, K_FOREVER);

    printk("Final counter value: %d\n", sharedCounter);
}
```

## src/Zephyr_Thread_Creation.c
```c
#include <zephyr.h>
#include <sys/printk.h>

#define STACK_SIZE 1024
#define PRIORITY 7

K_THREAD_STACK_DEFINE(thread_creation1_stack, STACK_SIZE);
K_THREAD_STACK_DEFINE(thread_creation2_stack, STACK_SIZE);
struct k_thread thread_creation1_data;
struct k_thread thread_creation2_data;

void thread1_function(void *arg1, void *arg2, void *arg3) {
    printk("Thread 1 is running\n");
}

void thread2_function(void *arg1, void *arg2, void *arg3) {
    printk("Thread 2 is running\n");
}

void main(void) {
    k_tid_t thread1_tid = k_thread_create(&thread_creation1_data, thread_creation1_stack, STACK_SIZE,
                                          thread1_function, NULL, NULL, NULL,
                                          PRIORITY, 0, K_NO_WAIT);

    k_tid_t thread2_tid = k_thread_create(&thread_creation2_data, thread_creation2_stack, STACK_SIZE,
                                          thread2_function, NULL, NULL, NULL,
                                          PRIORITY, 0, K_NO_WAIT);

    k_thread_join(thread1_tid, K_FOREVER);
    k_thread_join(thread2_tid, K_FOREVER);

    printk("Threads have finished execution\n");
}
```
