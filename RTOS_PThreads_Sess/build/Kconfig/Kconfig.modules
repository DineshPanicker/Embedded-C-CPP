## RTOS_PThreads_Sess/build/Kconfig/Kconfig.modules
```kconfig
menu "CANopenNode (/home/dinesh/Embedded-C-CPP/RTOS_PThreads_Sess/modules/lib/canopennode)"
osource "$(ZEPHYR_CANOPENNODE_KCONFIG)"
config ZEPHYR_CANOPENNODE_MODULE
	bool
	default y
endmenu
menu "hal_nordic (/home/dinesh/Embedded-C-CPP/RTOS_PThreads_Sess/modules/hal/nordic)"
osource "$(ZEPHYR_HAL_NORDIC_KCONFIG)"
config ZEPHYR_HAL_NORDIC_MODULE
	bool
	default y
endmenu
menu "hal_nxp (/home/dinesh/Embedded-C-CPP/RTOS_PThreads_Sess/modules/hal/nxp)"
osource "$(ZEPHYR_HAL_NXP_KCONFIG)"
config ZEPHYR_HAL_NXP_MODULE
	bool
	default y
endmenu
menu "loramac-node (/home/dinesh/Embedded-C-CPP/RTOS_PThreads_Sess/modules/lib/loramac-node)"
osource "$(ZEPHYR_LORAMAC_NODE_KCONFIG)"
config ZEPHYR_LORAMAC_NODE_MODULE
	bool
	default y
endmenu
menu "lz4 (/home/dinesh/Embedded-C-CPP/RTOS_PThreads_Sess/modules/lib/lz4)"
osource "$(ZEPHYR_LZ4_KCONFIG)"
config ZEPHYR_LZ4_MODULE
	bool
	default y
endmenu
menu "mbedtls (/home/dinesh/Embedded-C-CPP/RTOS_PThreads_Sess/modules/crypto/mbedtls)"
osource "$(ZEPHYR_MBEDTLS_KCONFIG)"
config ZEPHYR_MBEDTLS_MODULE
	bool
	default y
endmenu
menu "nanopb (/home/dinesh/Embedded-C-CPP/RTOS_PThreads_Sess/modules/lib/nanopb)"
osource "$(ZEPHYR_NANOPB_KCONFIG)"
config ZEPHYR_NANOPB_MODULE
	bool
	default y
endmenu
menu "sof (/home/dinesh/Embedded-C-CPP/RTOS_PThreads_Sess/modules/audio/sof)"
osource "/home/dinesh/Embedded-C-CPP/RTOS_PThreads_Sess/modules/audio/sof/zephyr/Kconfig"
config ZEPHYR_SOF_MODULE
	bool
	default y
endmenu
menu "tflite-micro (/home/dinesh/Embedded-C-CPP/RTOS_PThreads_Sess/modules/lib/tflite-micro)"
osource "$(ZEPHYR_TFLITE_MICRO_KCONFIG)"
config ZEPHYR_TFLITE_MICRO_MODULE
	bool
	default y
endmenu
menu "TraceRecorder (/home/dinesh/Embedded-C-CPP/RTOS_PThreads_Sess/modules/debug/TraceRecorder)"
osource "/home/dinesh/Embedded-C-CPP/RTOS_PThreads_Sess/modules/debug/TraceRecorder/kernelports/Zephyr/Kconfig"
config ZEPHYR_TRACERECORDER_MODULE
	bool
	default y
endmenu
menu "trusted-firmware-m (/home/dinesh/Embedded-C-CPP/RTOS_PThreads_Sess/modules/tee/tfm)"
osource "$(ZEPHYR_TRUSTED_FIRMWARE_M_KCONFIG)"
config ZEPHYR_TRUSTED_FIRMWARE_M_MODULE
	bool
	default y
endmenu
```

## RTOS_PThreads_Sess/build/Kconfig/arch/Kconfig
```kconfig
# Load arch Kconfig descriptions.
osource "/home/dinesh/Embedded-C-CPP/RTOS_PThreads_Sess/zephyr/arch/x86/Kconfig"
osource "/home/dinesh/Embedded-C-CPP/RTOS_PThreads_Sess/zephyr/arch/xtensa/Kconfig"
osource "/home/dinesh/Embedded-C-CPP/RTOS_PThreads_Sess/zephyr/arch/sparc/Kconfig"
osource "/home/dinesh/Embedded-C-CPP/RTOS_PThreads_Sess/zephyr/arch/riscv/Kconfig"
osource "/home/dinesh/Embedded-C-CPP/RTOS_PThreads_Sess/zephyr/arch/posix/Kconfig"
osource "/home/dinesh/Embedded-C-CPP/RTOS_PThreads_Sess/zephyr/arch/nios2/Kconfig"
osource "/home/dinesh/Embedded-C-CPP/RTOS_PThreads_Sess/zephyr/arch/mips/Kconfig"
osource "/home/dinesh/Embedded-C-CPP/RTOS_PThreads_Sess/zephyr/arch/arm64/Kconfig"
osource "/home/dinesh/Embedded-C-CPP/RTOS_PThreads_Sess/zephyr/arch/arm/Kconfig"
osource "/home/dinesh/Embedded-C-CPP/RTOS_PThreads_Sess/zephyr/arch/arc/Kconfig"
```

## RTOS_PThreads_Sess/build/Kconfig/soc/Kconfig
```kconfig
# Load Zephyr SoC Kconfig descriptions.
osource "/home/dinesh/Embedded-C-CPP/RTOS_PThreads_Sess/zephyr/soc/xlnx/zynqmp/Kconfig"
osource "/home/dinesh/Embedded-C-CPP/RTOS_PThreads_Sess/zephyr/soc/xlnx/zynq7000/Kconfig"
osource "/home/dinesh/Embedded-C-CPP/RTOS_PThreads_Sess/zephyr/soc/xen/Kconfig"
osource "/home/dinesh/Embedded-C-CPP/RTOS_PThreads_Sess/zephyr/soc/ti/simplelink/Kconfig"
osource "/home/dinesh/Embedded-C-CPP/RTOS_PThreads_Sess/zephyr/soc/ti/lm3s6965/Kconfig"
osource "/home/dinesh/Embedded-C-CPP/RTOS_PThreads_Sess/zephyr/soc/ti/k3/Kconfig"
osource "/home/dinesh/Embedded-C-CPP/RTOS_PThreads_Sess/zephyr/soc/telink/tlsr/Kconfig"
osource "/home/dinesh/Embedded-C-CPP/RTOS_PThreads_Sess/zephyr/soc/starfive/jh71xx/Kconfig"
osource "/home/dinesh/Embedded-C-CPP/RTOS_PThreads_Sess/zephyr/soc/st/stm32/Kconfig"
osource "/home/dinesh/Embedded-C-CPP/RTOS_PThreads_Sess/zephyr/soc/snps/qemu_arc/Kconfig"
osource "/home/dinesh/Embedded-C-CPP/RTOS_PThreads_Sess/zephyr/soc/snps/nsim/arc_v/Kconfig"
osource "/home/dinesh/Embedded-C-CPP/RTOS_PThreads_Sess/zephyr/soc/snps/nsim/arc_classic/Kconfig"
osource "/home/dinesh/Embedded-C-CPP/RTOS_PThreads_Sess/zephyr/soc/snps/hsdk4xd/Kconfig"
osource "/home/dinesh/Embedded-C-CPP/RTOS_PThreads_Sess/zephyr/soc/snps/hsdk/Kconfig"
osource "/home/dinesh/Embedded-C-CPP/RTOS_PThreads_Sess/zephyr/soc/snps/emsk/Kconfig"
osource "/home/dinesh/Embedded-C-CPP/RTOS_PThreads_Sess/zephyr/soc/snps/emsdp/Kconfig"
osource "/home/dinesh/Embedded-C-CPP/RTOS_PThreads_Sess/zephyr/soc/snps/arc_iot/Kconfig"
osource "/home/dinesh/Embedded-C-CPP/RTOS_PThreads_Sess/zephyr/soc/silabs/Kconfig"
osource "/home/dinesh/Embedded-C-CPP/RTOS_PThreads_Sess/zephyr/soc/sifive/sifive_freedom/Kconfig"
osource "/home/dinesh/Embedded-C-CPP/RTOS_PThreads_Sess/zephyr/soc/rockchip/Kconfig"
osource "/home/dinesh/Embedded-C-CPP/RTOS_PThreads_Sess/zephyr/soc/renode/riscv_virtual/Kconfig"
osource "/home/dinesh/Embedded-C-CPP/RTOS_PThreads_Sess/zephyr/soc/renesas/smartbond/Kconfig"
osource "/home/dinesh/Embedded-C-CPP/RTOS_PThreads_Sess/zephyr/soc/renesas/rzt2m/Kconfig"
osource "/home/dinesh/Embedded-C-CPP/RTOS_PThreads_Sess/zephyr/soc/renesas/rcar/Kconfig"
osource "/home/dinesh/Embedded-C-CPP/RTOS_PThreads_Sess/zephyr/soc/renesas/ra/Kconfig"
osource "/home/dinesh/Embedded-C-CPP/RTOS_PThreads_Sess/zephyr/soc/raspberrypi/Kconfig"
osource "/home/dinesh/Embedded-C-CPP/RTOS_PThreads_Sess/zephyr/soc/quicklogic/eos_s3/Kconfig"
osource "/home/dinesh/Embedded-C-CPP/RTOS_PThreads_Sess/zephyr/soc/qemu/virt_riscv/Kconfig"
osource "/home/dinesh/Embedded-C-CPP/RTOS_PThreads_Sess/zephyr/soc/qemu/malta/Kconfig"
osource "/home/dinesh/Embedded-C-CPP/RTOS_PThreads_Sess/zephyr/soc/openisa/rv32m1/Kconfig"
osource "/home/dinesh/Embedded-C-CPP/RTOS_PThreads_Sess/zephyr/soc/nxp/s32/Kconfig"
osource "/home/dinesh/Embedded-C-CPP/RTOS_PThreads_Sess/zephyr/soc/nxp/rw/Kconfig"
osource "/home/dinesh/Embedded-C-CPP/RTOS_PThreads_Sess/zephyr/soc/nxp/mcx/Kconfig"
osource "/home/dinesh/Embedded-C-CPP/RTOS_PThreads_Sess/zephyr/soc/nxp/lpc/Kconfig"
osource "/home/dinesh/Embedded-C-CPP/RTOS_PThreads_Sess/zephyr/soc/nxp/layerscape/Kconfig"
osource "/home/dinesh/Embedded-C-CPP/RTOS_PThreads_Sess/zephyr/soc/nxp/kinetis/Kconfig"
osource "/home/dinesh/Embedded-C-CPP/RTOS_PThreads_Sess/zephyr/soc/nxp/imxrt/Kconfig"
osource "/home/dinesh/Embedded-C-CPP/RTOS_PThreads_Sess/zephyr/soc/nxp/imx/Kconfig"
osource "/home/dinesh/Embedded-C-CPP/RTOS_PThreads_Sess/zephyr/soc/nuvoton/numicro/Kconfig"
osource "/home/dinesh/Embedded-C-CPP/RTOS_PThreads_Sess/zephyr/soc/nuvoton/numaker/Kconfig"
osource "/home/dinesh/Embedded-C-CPP/RTOS_PThreads_Sess/zephyr/soc/nuvoton/npcx/Kconfig"
osource "/home/dinesh/Embedded-C-CPP/RTOS_PThreads_Sess/zephyr/soc/nordic/Kconfig"
osource "/home/dinesh/Embedded-C-CPP/RTOS_PThreads_Sess/zephyr/soc/neorv32/Kconfig"
osource "/home/dinesh/Embedded-C-CPP/RTOS_PThreads_Sess/zephyr/soc/native/inf_clock/Kconfig"
osource "/home/dinesh/Embedded-C-CPP/RTOS_PThreads_Sess/zephyr/soc/microchip/miv/Kconfig"
osource "/home/dinesh/Embedded-C-CPP/RTOS_PThreads_Sess/zephyr/soc/microchip/mec/Kconfig"
osource "/home/dinesh/Embedded-C-CPP/RTOS_PThreads_Sess/zephyr/soc/mediatek/mtk_adsp/Kconfig"
osource "/home/dinesh/Embedded-C-CPP/RTOS_PThreads_Sess/zephyr/soc/lowrisc/opentitan/Kconfig"
osource "/home/dinesh/Embedded-C-CPP/RTOS_PThreads_Sess/zephyr/soc/litex/litex_vexriscv/Kconfig"
osource "/home/dinesh/Embedded-C-CPP/RTOS_PThreads_Sess/zephyr/soc/ite/ec/Kconfig"
osource "/home/dinesh/Embedded-C-CPP/RTOS_PThreads_Sess/zephyr/soc/intel/raptor_lake/Kconfig"
osource "/home/dinesh/Embedded-C-CPP/RTOS_PThreads_Sess/zephyr/soc/intel/lakemont/Kconfig"
osource "/home/dinesh/Embedded-C-CPP/RTOS_PThreads_Sess/zephyr/soc/intel/intel_socfpga_std/Kconfig"
osource "/home/dinesh/Embedded-C-CPP/RTOS_PThreads_Sess/zephyr/soc/intel/intel_socfpga/Kconfig"
osource "/home/dinesh/Embedded-C-CPP/RTOS_PThreads_Sess/zephyr/soc/intel/intel_niosv/Kconfig"
osource "/home/dinesh/Embedded-C-CPP/RTOS_PThreads_Sess/zephyr/soc/intel/intel_ish/Kconfig"
osource "/home/dinesh/Embedded-C-CPP/RTOS_PThreads_Sess/zephyr/soc/intel/intel_adsp/Kconfig"
osource "/home/dinesh/Embedded-C-CPP/RTOS_PThreads_Sess/zephyr/soc/intel/elkhart_lake/Kconfig"
osource "/home/dinesh/Embedded-C-CPP/RTOS_PThreads_Sess/zephyr/soc/intel/atom/Kconfig"
osource "/home/dinesh/Embedded-C-CPP/RTOS_PThreads_Sess/zephyr/soc/intel/apollo_lake/Kconfig"
osource "/home/dinesh/Embedded-C-CPP/RTOS_PThreads_Sess/zephyr/soc/intel/alder_lake/Kconfig"
osource "/home/dinesh/Embedded-C-CPP/RTOS_PThreads_Sess/zephyr/soc/infineon/cat3/Kconfig"
osource "/home/dinesh/Embedded-C-CPP/RTOS_PThreads_Sess/zephyr/soc/infineon/cat1b/Kconfig"
osource "/home/dinesh/Embedded-C-CPP/RTOS_PThreads_Sess/zephyr/soc/infineon/cat1a/Kconfig"
osource "/home/dinesh/Embedded-C-CPP/RTOS_PThreads_Sess/zephyr/soc/gd/gd32/Kconfig"
osource "/home/dinesh/Embedded-C-CPP/RTOS_PThreads_Sess/zephyr/soc/gaisler/leon3/Kconfig"
osource "/home/dinesh/Embedded-C-CPP/RTOS_PThreads_Sess/zephyr/soc/gaisler/gr716a/Kconfig"
osource "/home/dinesh/Embedded-C-CPP/RTOS_PThreads_Sess/zephyr/soc/espressif/Kconfig"
osource "/home/dinesh/Embedded-C-CPP/RTOS_PThreads_Sess/zephyr/soc/ene/kb1200/Kconfig"
osource "/home/dinesh/Embedded-C-CPP/RTOS_PThreads_Sess/zephyr/soc/efinix/sapphire/Kconfig"
osource "/home/dinesh/Embedded-C-CPP/RTOS_PThreads_Sess/zephyr/soc/cdns/xtensa_sample_controller/Kconfig"
osource "/home/dinesh/Embedded-C-CPP/RTOS_PThreads_Sess/zephyr/soc/cdns/dc233c/Kconfig"
osource "/home/dinesh/Embedded-C-CPP/RTOS_PThreads_Sess/zephyr/soc/brcm/bcmvk/Kconfig"
osource "/home/dinesh/Embedded-C-CPP/RTOS_PThreads_Sess/zephyr/soc/brcm/bcm2712/Kconfig"
osource "/home/dinesh/Embedded-C-CPP/RTOS_PThreads_Sess/zephyr/soc/brcm/bcm2711/Kconfig"
osource "/home/dinesh/Embedded-C-CPP/RTOS_PThreads_Sess/zephyr/soc/atmel/sam0/Kconfig"
osource "/home/dinesh/Embedded-C-CPP/RTOS_PThreads_Sess/zephyr/soc/atmel/sam/Kconfig"
osource "/home/dinesh/Embedded-C-CPP/RTOS_PThreads_Sess/zephyr/soc/aspeed/Kconfig"
osource "/home/dinesh/Embedded-C-CPP/RTOS_PThreads_Sess/zephyr/soc/arm/Kconfig"
osource "/home/dinesh/Embedded-C-CPP/RTOS_PThreads_Sess/zephyr/soc/arm/beetle/Kconfig"
osource "/home/dinesh/Embedded-C-CPP/RTOS_PThreads_Sess/zephyr/soc/andestech/Kconfig"
osource "/home/dinesh/Embedded-C-CPP/RTOS_PThreads_Sess/zephyr/soc/ambiq/Kconfig"
osource "/home/dinesh/Embedded-C-CPP/RTOS_PThreads_Sess/zephyr/soc/altr/zephyr_nios2f/Kconfig"
osource "/home/dinesh/Embedded-C-CPP/RTOS_PThreads_Sess/zephyr/soc/altr/qemu_nios2/Kconfig"
osource "/home/dinesh/Embedded-C-CPP/RTOS_PThreads_Sess/zephyr/soc/adi/max32/Kconfig"
```
